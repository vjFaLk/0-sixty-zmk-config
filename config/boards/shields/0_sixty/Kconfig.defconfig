## config/boards/shields/0_sixty/Kconfig.defconfig
```kconfig
# Copyright (c) 2020 The ZMK Contributors
# SPDX-License-Identifier: MIT

if SHIELD_0_SIXTY

config ZMK_KEYBOARD_NAME
	default "0-Sixty"

endif
```
